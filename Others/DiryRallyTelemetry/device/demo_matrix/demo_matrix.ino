//tm1,640-d,ual c,olor ,8x8 matrix
//high 8bit -> green
//low 8bit -> red
#define CLK 7
#define DIN 8
byte alphabet[11][16]={
  {0x7F, 0x09, 0x19, 0x29, 0x46, 0x00, 0x00, 0x00, 0x7F, 0x09, 0x19, 0x29, 0x46, 0x00, 0x00, 0x00},
  {0x00, 0x42, 0x7F, 0x40, 0x00, 0x00, 0x00, 0x00, 0x00, 0x42, 0x7F, 0x40, 0x00, 0x00, 0x00, 0x00},
  {0x42, 0x61, 0x51, 0x49, 0x46, 0x00, 0x00, 0x00, 0x42, 0x61, 0x51, 0x49, 0x46, 0x00, 0x00, 0x00},
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  {0x7F, 0x04, 0x08, 0x10, 0x7F, 0x00, 0x00, 0x00, 0x7F, 0x04, 0x08, 0x10, 0x7F, 0x00, 0x00, 0x00}
};


void start(){
  digitalWrite(CLK, HIGH);
  digitalWrite(DIN, HIGH);
  digitalWrite(DIN, LOW);
}
void stop(){
  digitalWrite(CLK, HIGH);
  digitalWrite(DIN, LOW);
  digitalWrite(DIN, HIGH);
}
void write_byte(byte b){
  static byte i;
  for(i=0; i<8; i++){
    if(b&0x01){
      //write HIGH
      digitalWrite(DIN, HIGH);
      digitalWrite(CLK, HIGH);
      digitalWrite(CLK, LOW);
    }else{
      //write LOW
      digitalWrite(DIN, LOW);
      digitalWrite(CLK, HIGH);
      digitalWrite(CLK, LOW);
    }
    b>>=1;
  }
}
void setup() {
  // put your setup code here, to run once:
  start();
  //set data mode -> chunk write
  write_byte(0x40);
  stop();

  start();
  //set diode mode -> open with max brightness
  write_byte(0x8f);
  stop();
}
void write_block(int slice){
  static byte c;
  start();
  //start from 0x00
  write_byte(0xc0);
  //write 16 bytes profile
  for(c=0; c<16; c++){
    write_byte(alphabet[slice][c]);
  }
  stop();
}
int x=0;
void loop() {
  // put your main code here, to run repeatedly:
  write_block(x);
  x=(x+1)%12;
  delay(200);
}
